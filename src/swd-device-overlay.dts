/dts-v1/;
/plugin/;

/ {
	fragment@0 {
		target-path = "/";
		__overlay__ {
			swd {
				compatible = "swd";
				swclk-gpios = <&gpio 27 0>;
				swdio-gpios = <&gpio 17 0>;
				core = "stm32f103c8t6";
				// core = "stm32f411ceu6";
			};
		};
	};	
};